## dts/bindings/hda/intel,zephyr-hda-dai.yaml
```yaml
# Copyright (c) 2022 Intel Corporation
#
# SPDX-License-Identifier: Apache-2.0

description: Intel HDA DAI controller

compatible: "intel,zephyr-hda-dai"

include: base.yaml
```

## tests/boards/intel_adsp/ssp/testcase.yaml
```yaml
common:
  tags: boards
tests:
  boards.intel_adsp.ssp:
    depends_on: dai
    platform_allow: intel_adsp_cavs25
```
